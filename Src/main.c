/**
  ******************************************************************************
  * @file           : main.c
  * @brief          : Main program body
  ******************************************************************************
  ** This notice applies to any and all portions of this file
  * that are not between comment pairs USER CODE BEGIN and
  * USER CODE END. Other portions of this file, whether 
  * inserted by the user or by software development tools
  * are owned by their respective copyright owners.
  *
  * COPYRIGHT(c) 2018 STMicroelectronics
  *
  * Redistribution and use in source and binary forms, with or without modification,
  * are permitted provided that the following conditions are met:
  *   1. Redistributions of source code must retain the above copyright notice,
  *      this list of conditions and the following disclaimer.
  *   2. Redistributions in binary form must reproduce the above copyright notice,
  *      this list of conditions and the following disclaimer in the documentation
  *      and/or other materials provided with the distribution.
  *   3. Neither the name of STMicroelectronics nor the names of its contributors
  *      may be used to endorse or promote products derived from this software
  *      without specific prior written permission.
  *
  * THIS SOFTWARE IS PROVIDED BY THE COPYRIGHT HOLDERS AND CONTRIBUTORS "AS IS"
  * AND ANY EXPRESS OR IMPLIED WARRANTIES, INCLUDING, BUT NOT LIMITED TO, THE
  * IMPLIED WARRANTIES OF MERCHANTABILITY AND FITNESS FOR A PARTICULAR PURPOSE ARE
  * DISCLAIMED. IN NO EVENT SHALL THE COPYRIGHT HOLDER OR CONTRIBUTORS BE LIABLE
  * FOR ANY DIRECT, INDIRECT, INCIDENTAL, SPECIAL, EXEMPLARY, OR CONSEQUENTIAL
  * DAMAGES (INCLUDING, BUT NOT LIMITED TO, PROCUREMENT OF SUBSTITUTE GOODS OR
  * SERVICES; LOSS OF USE, DATA, OR PROFITS; OR BUSINESS INTERRUPTION) HOWEVER
  * CAUSED AND ON ANY THEORY OF LIABILITY, WHETHER IN CONTRACT, STRICT LIABILITY,
  * OR TORT (INCLUDING NEGLIGENCE OR OTHERWISE) ARISING IN ANY WAY OUT OF THE USE
  * OF THIS SOFTWARE, EVEN IF ADVISED OF THE POSSIBILITY OF SUCH DAMAGE.
  *
  ******************************************************************************
  */
/* Includes ------------------------------------------------------------------*/
#include "main.h"
#include "stm32f4xx_hal.h"
#include "dma2d.h"
#include "i2c.h"
#include "ltdc.h"
#include "spi.h"
#include "gpio.h"
#include "fmc.h"

/* USER CODE BEGIN Includes */
#include "stm32f429i_discovery_lcd.h"
#include "stm32f429i_discovery_sdram.h"
#include "stm32f429i_discovery_ts.h"
#include "string.h"
/* USER CODE END Includes */

/* Private variables ---------------------------------------------------------*/

/* USER CODE BEGIN PV */
/* Private variables ---------------------------------------------------------*/

/* USER CODE END PV */

/* Private function prototypes -----------------------------------------------*/
void SystemClock_Config(void);

/* USER CODE BEGIN PFP */
/* Private function prototypes -----------------------------------------------*/

/* USER CODE END PFP */

/* USER CODE BEGIN 0 */
const unsigned char ImageBuffer[3498] = {0x42,0x4d,0xaa,0x0d,0,0,0,0,0,0,0x36,0,0,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0xff,0xff};
	
enum{
	DEBUG,
	HOME,
	MENU,
	CONFIG_FAN_SPEED,
	CONFIG_TEMP_ALARM,
	CONFIG_HUMID_ALARM,
	CONFIG_ALARM_SPEED
} state = DEBUG;

double temp = 25;
double humid = 60;
double speed = 30;
int selected_element = 0;
uint8_t buffer[30];
int last_x=0, last_y=0, last_state=0;
int redraw_info = 0;

void updateTemp() {
	temp = 25;
}
void updateHumid() {
	humid = 60;
}
void updateSpeed() {
	speed = 30;
}

void displayState() {
	if (state == DEBUG) {
		//BSP_LCD_DrawBitmap(1,60,(uint8_t*)ImageBuffer);
		if (redraw_info == 0) {
			BSP_LCD_Clear(LCD_COLOR_WHITE);
			BSP_LCD_SetTextColor(LCD_COLOR_RED);
			BSP_LCD_DisplayStringAtLine(0,(uint8_t*)"01234567890123");
		}
		
		sprintf((char*)buffer,"Tick=%08d",HAL_GetTick());
		BSP_LCD_DisplayStringAtLine(2,(uint8_t*)buffer);
		
		sprintf((char*)buffer,"X=%03d,Y=%03d", last_x, last_y);
		BSP_LCD_DisplayStringAtLine(4,(uint8_t*)buffer);
		
		sprintf((char*)buffer,"redraw=%03d ", redraw_info);
		BSP_LCD_DisplayStringAtLine(6,(uint8_t*)buffer);
	
		if (redraw_info == 0) {
			redraw_info = 1;
		} else if (redraw_info == 1) {
			redraw_info = 0;
		}
	} else if (state == HOME) {
		if (redraw_info == 0) {
			BSP_LCD_Clear(LCD_COLOR_WHITE);
			BSP_LCD_DisplayStringAtLine(1,(uint8_t*)"  DASHBOARD   ");
			redraw_info = 1;
		}
		sprintf((char*)buffer,"Tempe = %03.1f C", temp);
		BSP_LCD_DisplayStringAtLine(2,(uint8_t*)buffer);
		sprintf((char*)buffer,"Humid = %03.1f %", humid);
		BSP_LCD_DisplayStringAtLine(2,(uint8_t*)buffer);
		sprintf((char*)buffer,"Veloc = %03.1f m/s", speed);
		BSP_LCD_DisplayStringAtLine(2,(uint8_t*)buffer);
	} 
}

void updateReadings() {
	static int x = 0;
	switch (x) {
		case 0: updateTemp(); break;
		case 1: updateHumid(); break;
		case 2: updateSpeed(); break;
	}
	x++;
	HAL_Delay(10);
}

void checkAlarmState() {
	
}

typedef enum {
	TOUCH_START,
	TOUCH_MOVE,
	TOUCH_END
} EVENT_TYPE;

void processEvent(EVENT_TYPE type, int x, int y) {
	if (type == TOUCH_START) {
		if (state == DEBUG) {
			state = MENU;
			redraw_info = 0;
		} else if (state == MENU) {
			state = DEBUG;
			redraw_info = 0;
		}
	}
	last_x = x;
	last_y = y;
	last_state = (type == TOUCH_START || type == TOUCH_MOVE);
	if (redraw_info == 2) {
		redraw_info = 1;
	}
}

/* USER CODE END 0 */

/**
  * @brief  The application entry point.
  *
  * @retval None
  */
int main(void)
{
  /* USER CODE BEGIN 1 */
int last_state_was_down = 0;
TS_StateTypeDef TsState;
  /* USER CODE END 1 */

  /* MCU Configuration----------------------------------------------------------*/

  /* Reset of all peripherals, Initializes the Flash interface and the Systick. */
  HAL_Init();

  /* USER CODE BEGIN Init */

  /* USER CODE END Init */

  /* Configure the system clock */
  SystemClock_Config();

  /* USER CODE BEGIN SysInit */

  /* USER CODE END SysInit */

  /* Initialize all configured peripherals */
  MX_GPIO_Init();
  MX_DMA2D_Init();
  MX_FMC_Init();
  MX_LTDC_Init();
  MX_I2C3_Init();
  MX_SPI5_Init();
  /* USER CODE BEGIN 2 */
BSP_LCD_Init();
BSP_LCD_LayerDefaultInit(LCD_BACKGROUND_LAYER,LCD_FRAME_BUFFER);
BSP_LCD_LayerDefaultInit(LCD_FOREGROUND_LAYER,LCD_FRAME_BUFFER);
BSP_LCD_DisplayOn();
BSP_LCD_SelectLayer(LCD_FOREGROUND_LAYER);
BSP_TS_Init(240, 320);
unsigned long last_display_update = HAL_GetTick();
  /* USER CODE END 2 */

  /* Infinite loop */
  /* USER CODE BEGIN WHILE */
  while (1)
  {

  /* USER CODE END WHILE */

  /* USER CODE BEGIN 3 */
		updateReadings();
		// Handle periodic drawing (once every 16ms = 60FPS)
		int nowMS = HAL_GetTick();
		if (nowMS-last_display_update > 16) {
			last_display_update += 16;
			// Fix very slow cycles ahead
			if (nowMS-last_display_update > 16) {
				last_display_update = nowMS;
			}
			displayState();
		}
		checkAlarmState();
		
		BSP_TS_GetState(&TsState);
		if(TsState.TouchDetected)
		{
			if (last_state_was_down) {
				last_state_was_down = 1;
				processEvent(TOUCH_START, TsState.X, TsState.Y);
			} else {
				processEvent(TOUCH_MOVE, TsState.X, TsState.Y);
			}
		} else {
			if (last_state_was_down) {
				last_state_was_down = 0;
				processEvent(TOUCH_END, TsState.X, TsState.Y);
			}
		}
		HAL_Delay(10);
  }
  /* USER CODE END 3 */

}

/**
  * @brief System Clock Configuration
  * @retval None
  */
void SystemClock_Config(void)
{

  RCC_OscInitTypeDef RCC_OscInitStruct;
  RCC_ClkInitTypeDef RCC_ClkInitStruct;
  RCC_PeriphCLKInitTypeDef PeriphClkInitStruct;

    /**Configure the main internal regulator output voltage 
    */
  __HAL_RCC_PWR_CLK_ENABLE();

  __HAL_PWR_VOLTAGESCALING_CONFIG(PWR_REGULATOR_VOLTAGE_SCALE1);

    /**Initializes the CPU, AHB and APB busses clocks 
    */
  RCC_OscInitStruct.OscillatorType = RCC_OSCILLATORTYPE_HSE;
  RCC_OscInitStruct.HSEState = RCC_HSE_ON;
  RCC_OscInitStruct.PLL.PLLState = RCC_PLL_ON;
  RCC_OscInitStruct.PLL.PLLSource = RCC_PLLSOURCE_HSE;
  RCC_OscInitStruct.PLL.PLLM = 4;
  RCC_OscInitStruct.PLL.PLLN = 168;
  RCC_OscInitStruct.PLL.PLLP = RCC_PLLP_DIV2;
  RCC_OscInitStruct.PLL.PLLQ = 4;
  if (HAL_RCC_OscConfig(&RCC_OscInitStruct) != HAL_OK)
  {
    _Error_Handler(__FILE__, __LINE__);
  }

    /**Initializes the CPU, AHB and APB busses clocks 
    */
  RCC_ClkInitStruct.ClockType = RCC_CLOCKTYPE_HCLK|RCC_CLOCKTYPE_SYSCLK
                              |RCC_CLOCKTYPE_PCLK1|RCC_CLOCKTYPE_PCLK2;
  RCC_ClkInitStruct.SYSCLKSource = RCC_SYSCLKSOURCE_PLLCLK;
  RCC_ClkInitStruct.AHBCLKDivider = RCC_SYSCLK_DIV1;
  RCC_ClkInitStruct.APB1CLKDivider = RCC_HCLK_DIV4;
  RCC_ClkInitStruct.APB2CLKDivider = RCC_HCLK_DIV2;

  if (HAL_RCC_ClockConfig(&RCC_ClkInitStruct, FLASH_LATENCY_5) != HAL_OK)
  {
    _Error_Handler(__FILE__, __LINE__);
  }

  PeriphClkInitStruct.PeriphClockSelection = RCC_PERIPHCLK_LTDC;
  PeriphClkInitStruct.PLLSAI.PLLSAIN = 216;
  PeriphClkInitStruct.PLLSAI.PLLSAIR = 2;
  PeriphClkInitStruct.PLLSAIDivR = RCC_PLLSAIDIVR_2;
  if (HAL_RCCEx_PeriphCLKConfig(&PeriphClkInitStruct) != HAL_OK)
  {
    _Error_Handler(__FILE__, __LINE__);
  }

    /**Configure the Systick interrupt time 
    */
  HAL_SYSTICK_Config(HAL_RCC_GetHCLKFreq()/1000);

    /**Configure the Systick 
    */
  HAL_SYSTICK_CLKSourceConfig(SYSTICK_CLKSOURCE_HCLK);

  /* SysTick_IRQn interrupt configuration */
  HAL_NVIC_SetPriority(SysTick_IRQn, 0, 0);
}

/* USER CODE BEGIN 4 */

/* USER CODE END 4 */

/**
  * @brief  This function is executed in case of error occurrence.
  * @param  file: The file name as string.
  * @param  line: The line in file as a number.
  * @retval None
  */
void _Error_Handler(char *file, int line)
{
  /* USER CODE BEGIN Error_Handler_Debug */
  /* User can add his own implementation to report the HAL error return state */
  while(1)
  {
  }
  /* USER CODE END Error_Handler_Debug */
}

#ifdef  USE_FULL_ASSERT
/**
  * @brief  Reports the name of the source file and the source line number
  *         where the assert_param error has occurred.
  * @param  file: pointer to the source file name
  * @param  line: assert_param error line source number
  * @retval None
  */
void assert_failed(uint8_t* file, uint32_t line)
{ 
  /* USER CODE BEGIN 6 */
  /* User can add his own implementation to report the file name and line number,
     tex: printf("Wrong parameters value: file %s on line %d\r\n", file, line) */
  /* USER CODE END 6 */
}
#endif /* USE_FULL_ASSERT */

/**
  * @}
  */

/**
  * @}
  */

/************************ (C) COPYRIGHT STMicroelectronics *****END OF FILE****/

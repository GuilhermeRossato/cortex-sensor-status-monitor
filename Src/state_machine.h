
// PA5 = POT
// PG1, PG2 = I2C

#define potenciometro 5
enum {
	DEBUG,
	HOME,
	MENU,
	CONFIG_TEMP_ALARM,
	CONFIG_HUMID_ALARM,
	CONFIG_SPEED_ALARM,
	ERROR_MODE
} state = HOME;

typedef struct {
	unsigned char updated;
	unsigned long raw;
	double value;
	double min, max;
} control_unit;

control_unit temp, humid, speed;

uint8_t buffer[30];
int last_x=0, last_y=0, last_state=0;
int redraw_info = 0;
int errNumber = 0;
int last_state_was_down = 0;
int pot_value = 0;

void init_state_machine() {
	temp.min = 20;
	temp.max = 40;
	humid.min = 50;
	humid.max = 80;
	speed.min = 10;
	speed.max = 40;
}

const unsigned char failure_img[854]={0x42,0x4d,0x56,0x03,0x00,0x00,0x00,0x00,0x00,0x00,0x36,0x00,0x00,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0xff,0xff};
const unsigned char success_img[854]={0x42,0x4d,0x56,0x03,0x00,0x00,0x00,0x00,0x00,0x00,0x36,0x00,0x00,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0xff,0xff};
extern int last_pwm_count; // from main TIM2 interrupt
	
void displayState() {
	speed.raw = last_pwm_count;
	speed.value = speed.raw * 0.02f;
	static int substate = 0;
	int updateSomething = (redraw_info == 0 || temp.updated || humid.updated || speed.updated);
	if (state == DEBUG) {
		//BSP_LCD_DrawBitmap(1,60,(uint8_t*)ImageBuffer);
		if (redraw_info == 0) {
			substate = 0;
			BSP_LCD_Clear(LCD_COLOR_WHITE);
			BSP_LCD_SetTextColor(LCD_COLOR_RED);
			//BSP_LCD_DisplayStringAtLine(0,(uint8_t*)"01234567890123");
			BSP_LCD_DisplayStringAt(0,279,(uint8_t*)"VOLTAR ", RIGHT_MODE);
			BSP_LCD_DrawRect(111, 268, 115, 40);
		}

		sprintf((char*)buffer,"Tick=%4.2f s",HAL_GetTick()/1000.0);
		BSP_LCD_DisplayStringAtLine(2,(uint8_t*)buffer);
		
		sprintf((char*)buffer,"Pot=%4d/4096",4096-pot_value);
		BSP_LCD_DisplayStringAtLine(0,(uint8_t*)buffer);
		
		//sprintf((char*)buffer,"Pwm=%4d u",last_pwm_count);
		//BSP_LCD_DisplayStringAtLine(1,(uint8_t*)buffer);

		sprintf((char*)buffer,"X=%03d,Y=%03d", last_x, last_y);
		BSP_LCD_DisplayStringAtLine(4,(uint8_t*)buffer);

		if (errNumber != 0) {
			sprintf((char*)buffer,"errNumber=%03d ", errNumber);
			BSP_LCD_DisplayStringAtLine(6,(uint8_t*)buffer);
		} else if (updateSomething) {
			BSP_LCD_SetFont(&Font16);
			sprintf((char*)buffer," Temp  = %4.3f 'C", temp.value);
			BSP_LCD_DisplayStringAtLine(8,(uint8_t*)buffer);
			sprintf((char*)buffer," (raw) = %4d", temp.raw);
			BSP_LCD_DisplayStringAtLine(9,(uint8_t*)buffer);
			sprintf((char*)buffer," Humid = %4.3f %%", humid.value);
			BSP_LCD_DisplayStringAtLine(11,(uint8_t*)buffer);
			sprintf((char*)buffer," (raw) = %4d", humid.raw);
			BSP_LCD_DisplayStringAtLine(12,(uint8_t*)buffer);
			sprintf((char*)buffer," Veloc = %4.3f m/s", speed.value);
			BSP_LCD_DisplayStringAtLine(14,(uint8_t*)buffer);
			sprintf((char*)buffer," (raw) = %4d", speed.raw);
			BSP_LCD_DisplayStringAtLine(15,(uint8_t*)buffer);
			BSP_LCD_SetFont(&Font24);
			temp.updated = 0;
			humid.updated = 0;
			speed.updated = 0;
		}

		substate++;
		if (redraw_info == 0) {
			redraw_info = 1;
		} else if (redraw_info == 1) {
			redraw_info = 2;
		} else if (redraw_info == 2) {
			redraw_info = 0;
		}
	} else if (state == HOME) {
		if (redraw_info == 0) {
			BSP_LCD_Clear(LCD_COLOR_WHITE);
			BSP_LCD_SetTextColor(LCD_COLOR_BLACK);
			BSP_LCD_DisplayStringAtLine(1,(uint8_t*)"  Trabalho 1  ");
			redraw_info = 1;
			BSP_LCD_DisplayStringAtLine(7,(uint8_t*)"   Alarmes   ");
			
			BSP_LCD_DisplayStringAt(1, 279,(uint8_t*)"CONFIG ", RIGHT_MODE);
			BSP_LCD_DrawRect(115, 268, 113, 40);
			BSP_LCD_DisplayStringAt(15,279,(uint8_t*)"DEBUG", LEFT_MODE);
			BSP_LCD_DrawRect(7, 268, 100, 40);
			
			BSP_LCD_DisplayStringAtLine(10,(uint8_t*)"  T   H    V");
			
			//sprintf((char*)buffer," DEBUG CONFIG "); BSP_LCD_DisplayStringAtLine(11,(uint8_t*)buffer);
			//BSP_LCD_DrawRect(8, 11*23+3, 102, 30);
			//BSP_LCD_DrawRect(113, 11*23+3, 114, 30);
		}
		if (updateSomething) {
			sprintf((char*)buffer,"Temp  = %03.1f C", temp.value);
			BSP_LCD_DisplayStringAtLine(3,(uint8_t*)buffer);
			sprintf((char*)buffer,"Humid = %03.1f %%", humid.value);
			BSP_LCD_DisplayStringAtLine(4,(uint8_t*)buffer);
			sprintf((char*)buffer,"Vel = %03.1f m/s", speed.value);
			BSP_LCD_DisplayStringAtLine(5,(uint8_t*)buffer);
			temp.updated = 0;
			humid.updated = 0;
			speed.updated = 0;
			
			uint8_t * status_img;
			/* show status */
			status_img = (temp.value < temp.min || temp.value > temp.max) ?  ((uint8_t *) failure_img) : ((uint8_t *) success_img);
			BSP_LCD_DrawBitmap(40-10, 210, status_img);
			status_img = (humid.value < humid.min || humid.value > humid.max) ?  ((uint8_t *) failure_img) : ((uint8_t *) success_img);
			BSP_LCD_DrawBitmap(120-10, 210, status_img);
			status_img = (speed.value*20.0f < speed.min || speed.value*20.0f > speed.max) ?  ((uint8_t *) failure_img) : ((uint8_t *) success_img);
			BSP_LCD_DrawBitmap(200-10, 210, status_img);
		}
	} else if (state == MENU) {
		if (redraw_info == 0) {
			redraw_info = 1;
			BSP_LCD_Clear(LCD_COLOR_WHITE);
			BSP_LCD_SetTextColor(LCD_COLOR_BLACK);
			BSP_LCD_DisplayStringAtLine(1,(uint8_t*)"     MENU     ");
			BSP_LCD_DisplayStringAtLine(2,(uint8_t*)"  DE LIMITES  ");
			
			BSP_LCD_DisplayStringAt(0,40*3+5-10,(uint8_t*)"LIMITE TEMP", CENTER_MODE);
			BSP_LCD_DisplayStringAt(0,40*4+5,(uint8_t*)"LIMITE HUMID", CENTER_MODE);
			BSP_LCD_DisplayStringAt(0,40*5+5+10,(uint8_t*)"LIMITE VELOC", CENTER_MODE);
			
			BSP_LCD_DisplayStringAt(0,40*7+5,(uint8_t*)"VOLTAR", CENTER_MODE);
			BSP_LCD_DrawRect(10, 40*3-10, 220, 30);
			BSP_LCD_DrawRect(10, 40*4, 220, 30);
			BSP_LCD_DrawRect(10, 40*5+10, 220, 30);
			BSP_LCD_DrawRect(10, 40*7, 220, 30);
		}
	} else if (state == CONFIG_TEMP_ALARM || state == CONFIG_HUMID_ALARM || state == CONFIG_SPEED_ALARM) {
		if (redraw_info == 0) {
			BSP_LCD_Clear(LCD_COLOR_WHITE);
			BSP_LCD_SetTextColor(LCD_COLOR_BLACK);
			init_slider(0, 10, 120, 2);
			if (state == CONFIG_SPEED_ALARM) {
				BSP_LCD_DisplayStringAtLine(1,(uint8_t*)" CONFIG DE    ");
				BSP_LCD_DisplayStringAtLine(2,(uint8_t*)"  VELOCIDADE  ");
				double min = speed.min, max = speed.max;
				// speed goes from 0 to 100, slider goes up to 220
				set_slider_values(0, min*2.2f, max*2.2f, 0);
			} else if (state == CONFIG_TEMP_ALARM) {
				BSP_LCD_DisplayStringAtLine(1,(uint8_t*)" CONFIG DE    ");
				BSP_LCD_DisplayStringAtLine(2,(uint8_t*)"  TEMPERATURA ");
				double min = temp.min, max = temp.max;
				// temp goes from 0 to 100, slider goes up to 220
				set_slider_values(0, min*2.2f, max*2.2f, 0);
			} else if (state == CONFIG_HUMID_ALARM) {
				double min = temp.min, max = temp.max;
				// humid goes from 0 to 100, slider goes up to 220
				set_slider_values(0, min*2.2f, max*2.2f, 0);
				BSP_LCD_DisplayStringAtLine(1,(uint8_t*)" CONFIG DE    ");
				BSP_LCD_DisplayStringAtLine(2,(uint8_t*)"   HUMIDADE   ");
			}
			redraw_info = 1;
			BSP_LCD_DisplayStringAt(0,40*7+5,(uint8_t*)"VOLTAR", CENTER_MODE);
			BSP_LCD_DrawRect(10, 40*7, 220, 30);
		}
		draw_slider(0);
		if (updateSomething) {
			if (state == CONFIG_TEMP_ALARM) {
				sprintf((char*)buffer,"Temp = %02.1f 'C", temp.value);
			} else if (state == CONFIG_HUMID_ALARM) {
				sprintf((char*)buffer,"Humid = %03.1f %%", humid.value);
			} else if (state == CONFIG_SPEED_ALARM) {
				sprintf((char*)buffer,"Vel = %03.1f m/s", speed.value);
			}
			BSP_LCD_DisplayStringAtLine(4,(uint8_t*)buffer);

			if (state == CONFIG_TEMP_ALARM) {
				sprintf((char*)buffer," MIN = %02.1f 'C", temp.min);
			} else if (state == CONFIG_HUMID_ALARM) {
				sprintf((char*)buffer," MIN = %03.1f %%", humid.min);
			} else if (state == CONFIG_SPEED_ALARM) {
				sprintf((char*)buffer,"MIN = %03.1f m/s", speed.min/20.0f);
			}
			BSP_LCD_DisplayStringAtLine(8,(uint8_t*)buffer);
			updateSomething = 0;
			temp.updated = 0;
			humid.updated = 0;
			speed.updated = 0;
		}

		if (state == CONFIG_TEMP_ALARM) {
			sprintf((char*)buffer," MAX = %02.1f 'C", temp.max);
		} else if (state == CONFIG_HUMID_ALARM) {
			sprintf((char*)buffer," MAX = %03.1f %%", humid.max);
		} else if (state == CONFIG_SPEED_ALARM) {
			sprintf((char*)buffer,"MAX = %03.1f m/s", speed.max/20.0f);
		}
		BSP_LCD_DisplayStringAtLine(9,(uint8_t*)buffer);
	} else if (state == ERROR_MODE) {
		if (redraw_info == 0) {
			BSP_LCD_Clear(LCD_COLOR_WHITE);
			BSP_LCD_DisplayStringAtLine(1,(uint8_t*)"     ERRO     ");
			sprintf((char*)buffer,"errNumber=%03d ", errNumber);
			BSP_LCD_DisplayStringAtLine(6,(uint8_t*)buffer);
		}
	}
	if (errNumber != 0) {
		redraw_info = 0;
		state = ERROR_MODE;
	}
}

/* called by slider_component.h */
void on_slider_value_change(int slider_id, int slider_selection, int value) {
	if (state == CONFIG_TEMP_ALARM && slider_selection == 0) {
		temp.min = value/2.2f;
	} else if (state == CONFIG_TEMP_ALARM && slider_selection == 1) {
		temp.max = value/2.2f;
	} else if (state == CONFIG_HUMID_ALARM && slider_selection == 0) {
		humid.min = value/2.2f;
	} else if (state == CONFIG_HUMID_ALARM && slider_selection == 1) {
		humid.max = value/2.2f;
	} else if (state == CONFIG_SPEED_ALARM && slider_selection == 0) {
		speed.min = value/2.2f;
	} else if (state == CONFIG_SPEED_ALARM && slider_selection == 1) {
		speed.max = value/2.2f;
	} else {
		errNumber = 8; // Unknown slider changed
	}
}

typedef enum {
	TOUCH_START=1,
	TOUCH_MOVE=2,
	TOUCH_END=3
} EVENT_TYPE;

int is_mouse_within(int mx, int my, int left, int top, int width, int height) {
	return (mx > left-5 && mx < left+width+5 && my > top-5 && my < top+height+5);
}

void processEvent(EVENT_TYPE type, int x, int y) {
	if (type == TOUCH_START) {
		if (state == DEBUG) {
			if (x > 111-5 && x < 111+115+5 && y > 268-5 && y < 265+40+5) {
				state = HOME;
				redraw_info = 0;
			}
		} else if (state == HOME) {
			/*BSP_LCD_DrawRect(118, 268, 110, 40);
			BSP_LCD_DisplayStringAt(15,279,(uint8_t*)"DEBUG", LEFT_MODE);
			BSP_LCD_DrawRect(7, 268, 100, 40);*/
			if (x > 118-5 && x < 118+110+5 && y > 268-5 && y < 265+40+5) {
				state = MENU;
			} else if (x > 7-5 && x < 7+100+5 && y > 268-5 && y < 265+40+5) {
				state = DEBUG;
			}
			redraw_info = 0;
		} else if (state == MENU) {
			if (is_mouse_within(x, y, 10, 40*2, 220, 30)) {
				//state = CONFIG_FAN_SPEED;
			} else if (is_mouse_within(x, y, 10, 40*3-20, 220, 40)) {
				state = CONFIG_TEMP_ALARM;
			} else if (is_mouse_within(x, y, 10, 40*4, 220, 30)) {
				state = CONFIG_HUMID_ALARM;
			} else if (is_mouse_within(x, y, 10, 40*5+10, 220, 40)) {
				state = CONFIG_SPEED_ALARM;
			} else if (is_mouse_within(x, y, 10, 40*7, 220, 30)) {
				state = HOME;
			}
			redraw_info = 0;
		}
	}
	if (state == CONFIG_TEMP_ALARM || state == CONFIG_HUMID_ALARM || state == CONFIG_SPEED_ALARM) {
		if (type == TOUCH_START && is_mouse_within(x, y, 10, 40*7, 220, 30)) {
			state = MENU;
			redraw_info = 0;
		} else {
			if (type == TOUCH_START) {
				slider_handle_mouse_down(x, y);
			} else if (type == TOUCH_MOVE) {
				slider_handle_mouse_move(x, y);
			} else if (type == TOUCH_END) {
				slider_handle_mouse_up(x, y);
			}
		}
		return;
	}
	last_x = x;
	last_y = y;
	last_state = type;
	//last_state = (type == TOUCH_START || type == TOUCH_MOVE);
	if (redraw_info == 2) {
		redraw_info = 1;
	}
}


void updateReadings() {
	static int x = 0;
	static unsigned char b1, b2;
	static unsigned long last_request = 0;
	unsigned long difTime;
	int ack;
	double raw;
	switch (x) {
		case 0: // Start communication
			start_i2c_SHT(); break;
		case 1: // Request humidity
			envia_byte_i2c(0x05);
			ack = read_ack_i2c();
			if (ack == 1) {
				errNumber = 1;
				x = -1;
			} else {
				last_request = HAL_GetTick();
				set_SDA_as_input();
			}
			break;
		case 2: // Wait for response of humidity
			difTime = HAL_GetTick()-last_request;
			if (difTime > 140) {
				errNumber = 2; // Timeout
				x = -1;
			} else if (difTime > 40) {
				if (difTime < 70) {
					HAL_Delay(2);
				}
				if (R(G, SDA) == 0) {
					b1 = 0;
					b2 = 0;
				} else {
					x--;
				}
			} else if (difTime > 0) {
				HAL_Delay(2);
				x--;
			} else {
				 x = -1; errNumber = 3; // Internally too fast
			}
			break;
		case 3:
			b1 = le_byte_i2c();
			break;
		case 4:
			b2 = le_byte_i2c();
			break;
		case 5:
			raw = ((0xf & b1) << 8) | b2;
			if (humid.raw != raw) {
				humid.raw = raw;
				humid.value = (double) -2.0468F+((0.0367F)*(raw))-((1.5955E-6)*(raw*raw));
				humid.updated = 1;
			}
			break;
		case 6:
			break;
		case 7:
			start_i2c_SHT();
			break;
		case 8: // Request temp
			envia_byte_i2c(0x03);
			ack = read_ack_i2c();
			if (ack == 1) {
				x = -1; errNumber = 4;
			} else {
				last_request = HAL_GetTick();
				set_SDA_as_input();
			}
			break;
		case 9: // Wait for response of temp
			difTime = HAL_GetTick()-last_request;
			if (difTime > 340) {
				errNumber = 5; // Timeout
				x = -1;
			} else if (difTime > 50) {
				if (difTime < 70) {
					HAL_Delay(2);
				}
				if (R(G, SDA) == 0) {
					b1 = 0;
					b2 = 0;
				} else {
					x--;
				}
			} else if (difTime > 0) {
				HAL_Delay(2);
				x--;
			} else {
				 x = -1; errNumber = 6; // Internally too fast
			}
			break;
		case 10:
			b1 = le_byte_i2c();
			break;
		case 11:
			b2 = le_byte_i2c();
			break;
		case 12:
			raw = ((0xf & b1) << 8) | b2;
			if (temp.raw != raw) {
				temp.raw = raw;
				temp.value = (double) 0.025F*((double)raw)-36.6F;
				temp.updated = 1;
			}
			break;
		case 13:
			x = 0;
			start_i2c_SHT();
			break;
	}
	if (x >= 0 && x <= 20) {
		x = x>20?0:x+1;
	}
}
